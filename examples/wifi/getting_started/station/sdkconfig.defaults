## examples/wifi/getting_started/station/sdkconfig.defaults
```kconfig
CONFIG_ESP32_ENABLE_COREDUMP_TO_FLASH=y

CONFIG_ESPTOOLPY_FLASHSIZE_4MB=y

# Increase main task stack size
CONFIG_ESP_MAIN_TASK_STACK_SIZE=7168
CONFIG_FREERTOS_TIMER_TASK_STACK_DEPTH=3072

# Enable filesystem
CONFIG_PARTITION_TABLE_CUSTOM=y
CONFIG_PARTITION_TABLE_CUSTOM_FILENAME="partitions.csv"
CONFIG_PARTITION_TABLE_FILENAME="partitions.csv"

# Enable FreeRTOS stats formatting functions, needed for 'tasks' command
CONFIG_FREERTOS_USE_TRACE_FACILITY=y
CONFIG_FREERTOS_USE_STATS_FORMATTING_FUNCTIONS=y

# Set WiFi SSID + password here
CONFIG_ESP_WIFI_SSID="myssid"
CONFIG_ESP_WIFI_PASSWORD="mypassword"
```
